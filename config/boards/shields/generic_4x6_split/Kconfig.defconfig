## config/boards/shields/generic_4x6_split/Kconfig.defconfig
```kconfig
config ZMK_USB
    default n

config ZMK_BLE
    default y

if SHIELD_GENERIC_4X6_SPLIT_LEFT ||  SHIELD_GENERIC_4X6_SPLIT_RIGHT

config ZMK_KEYBOARD_NAME
    default "ushio_split48"
    
config ZMK_SPLIT
    default y

endif

if SHIELD_GENERIC_4X6_SPLIT_LEFT

config ZMK_KEYBOARD_NAME
    default "ushio_split48"

config ZMK_SPLIT_BLE_ROLE_CENTRAL
	default y

endif
```

## config/boards/shields/generic_4x6_split/Kconfig.shield
```kconfig
config SHIELD_GENERIC_4X6_SPLIT_LEFT
    def_bool $(shields_list_contains, generic_4x6_split_left)

config SHIELD_GENERIC_4X6_SPLIT_RIGHT
    def_bool $(shields_list_contains, generic_4x6_split_right)
```
